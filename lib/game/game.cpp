#include "game.h"
/*---------------- 子弹 ----------------*/


// const int Bullet::MAX_BULLETS; // 如果编译器不支持类内常量初始化，需定义

void Bullet::spawn(int16_t px, int16_t py) {
    alive = true;
    rect.x = px - rect.w / 2;
    rect.y = py - rect.h;
    
  }

void Bullet::update() {
  if(alive){
    rect.y-=2;
    if (rect.y < 0 ) alive = false;
  }
  
    
  }
void Bullet::draw(U8G2_SSD1306_128X64_NONAME_1_HW_I2C& u8g2) const {
   if(alive) u8g2.drawBox(rect.x, rect.y, rect.w, rect.h);

  }

/*---------------- 陨石 ----------------*/

void Rock::begin(Rect game_screen){
    game_screen_rect=game_screen;
  }

void Rock::spawn() {
    alive = true;
    rect.x = random(game_screen_rect.left+rect.w, game_screen_rect.right - rect.w);
    rect.y = 0;
  }



void Rock::update() {
    if (alive) {
      ++rect.y;
      if (rect.y >= 64) alive = false;
    }
  }
void Rock::draw(U8G2_SSD1306_128X64_NONAME_1_HW_I2C& u8g2) const {
    if(alive) {
      u8g2.drawBox(rect.x, rect.y, rect.w, rect.h);
    }
  }

/*---------------- 飞机 ----------------*/
static const unsigned char plane_bitmap_bytes[] = {
    0x00, 0x00, 
    0x01, 0x80, 
    0x16, 0x68, 
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    0x06, 0x60
};


void Plane::begin(PS2& ps2,Rect game_screen){
    game_screen_rect=game_screen;
    ps2_class=&ps2;
}


void Plane::plane_control(){
  // Serial.printf("x:%d,y:%d\n",rect.x,rect.y);
  PS2::key_state_t key_state=ps2_class->get_key_state();
  switch (key_state)
  {
  case PS2::key_up:if(rect.y >game_screen_rect.top) --rect.y;  break;
  case PS2::key_down: if(rect.y<game_screen_rect.bottom-rect.h) ++rect.y;  break;
  case PS2::key_left:if(rect.x >game_screen_rect.left) --rect.x;  break;
  case PS2::key_right:if(rect.x<game_screen_rect.right-rect.w) ++rect.x;  break;
  
  }
}

void Plane::update() {
  if(alive) plane_control();
  }

void Plane::draw(U8G2_SSD1306_128X64_NONAME_1_HW_I2C& u8g2) const {
    if(alive) u8g2.drawBitmap(rect.x, rect.y,16/8,8,plane_bitmap_bytes); 
}

/*---------------- 游戏管理 ----------------*/

static const unsigned char game_over_bitmap_bytes[] = {
    0x00, 0x00, 0x00, 0x00, 0x00, 0x00, 0x00, 0x00, 0x00, 0x00, 0x00, 0x00, 0x00, 0x00, 0x00, 0x00, 
    0x00, 0x00, 0x00, 0x00, 0x00, 0x00, 0x00, 0x00, 0x00, 0x00, 0x00, 0x00, 0x00, 0x00, 0x00, 0x00, 
    0x00, 0x00, 0x00, 0x00, 0x00, 0x00, 0x00, 0x00, 0x00, 0x00, 0x00, 0x00, 0x00, 0x00, 0x00, 0x00, 
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    0x00, 0x00, 0x00, 0x00, 0x00, 0x00, 0x00, 0x00, 0x00, 0x00, 0x00, 0x00, 0x00, 0x00, 0x00, 0x00
};

void Game::begin(Rect screen,Rect game_screen,PS2& ps2) {
    plane.begin(ps2,game_screen);
    rock.begin(game_screen);
    game_screen_rect=game_screen;
    randomSeed(20250929);
  }

void Game::spawn_bullets(){
    if(!bullets[nextIdx].alive&&Timer(50)){
      bullets[nextIdx].spawn(plane.rect.x+plane.rect.w/2, plane.rect.y);
      nextIdx = (nextIdx+1) % bullet_cnt_max;
      }
    }

void Game::update_bullets(){
      for(auto& b: bullets) b.update();
    }

void Game::draw_bullets(U8G2_SSD1306_128X64_NONAME_1_HW_I2C& u8g2) const{
      for(auto& b: bullets) b.draw(u8g2);
}

void Game::collision(){
  for(auto& b: bullets){
    if(b.rect.hit(rock.rect)){
      b.alive=false;
      rock.alive=false;
      score++;
    }
  }
  if(plane.rect.hit(rock.rect)){
    plane.alive=false;
    is_game_over=true;
  }
}

void Game::draw_game_over(U8G2_SSD1306_128X64_NONAME_1_HW_I2C& u8g2){
    u8g2.drawBitmap(0,0,128/8,64,game_over_bitmap_bytes);
}
void Game::update() {
  rock.update();
  plane.update();
  update_bullets();
  spawn_bullets();
  
  if(!rock.alive){
    rock.spawn();
  }
  
}

void Game::draw(U8G2_SSD1306_128X64_NONAME_1_HW_I2C& u8g2) {
    
    rock.draw(u8g2);
    draw_bullets(u8g2);
    plane.draw(u8g2);
    
    u8g2.setCursor(0, 10);
    u8g2.print("S");
    u8g2.setCursor(0, 10+u8g2.getMaxCharHeight());
    u8g2.print(score);

    u8g2.drawVLine(game_screen_rect.left,game_screen_rect.y,game_screen_rect.h);
    u8g2.drawVLine(game_screen_rect.right,game_screen_rect.y,game_screen_rect.h);

   
}

void Game::loop(U8G2_SSD1306_128X64_NONAME_1_HW_I2C& u8g2) {
    // uint32_t now = millis();
    // if (now - lastFrame >= FRAME_MS) {
    //   lastFrame = now;
    if(!is_game_over){
      update();
      collision();
      draw(u8g2);
    }
    else{
      draw_game_over(u8g2);
    }
      
}
  