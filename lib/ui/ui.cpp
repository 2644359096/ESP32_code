#include "ui.h"
static const unsigned char logo_bitmap_bytes[] = {
    0xff, 0xff, 0xff, 0xff, 0xff, 0xff, 0xff, 0xff, 0xff, 0xff, 0xff, 0xff, 0xff, 0xff, 0xff, 0xff, 
    0xff, 0xff, 0xff, 0xff, 0xff, 0xff, 0xff, 0xff, 0xff, 0xff, 0xff, 0xff, 0xff, 0xff, 0xff, 0xff, 
    0xff, 0xff, 0xd8, 0x78, 0x01, 0xff, 0xff, 0xff, 0xfc, 0x03, 0xff, 0xff, 0xff, 0xff, 0xff, 0xff, 
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    0xff, 0xff, 0xff, 0xff, 0xff, 0xff, 0xff, 0xff, 0xff, 0xff, 0xff, 0xff, 0xff, 0xff, 0xff, 0xff
};
static const unsigned char menu_start_bitmap_bytes[] = {
    0x00, 0x00, 0x00, 0x00, 0x00, 0x00, 0x00, 0x00, 
    0x00, 0x00, 0x00, 0x00, 0x00, 0x00, 0x00, 0x00, 
    0x00, 0x3f, 0xe0, 0x00, 0x00, 0x07, 0xfe, 0x00, 
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    0x00, 0x00, 0x00, 0x00, 0x00, 0x00, 0x00, 0x00
};
static const unsigned char menu_help_bitmap_bytes[] = {
    0x00, 0x00, 0x00, 0x01, 0x00, 0x00, 0x00, 0x00, 
    0x00, 0x00, 0x00, 0x0f, 0xc0, 0x00, 0x00, 0x00, 
    0x00, 0x00, 0x00, 0xff, 0xf0, 0x00, 0x00, 0x00, 
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    0x00, 0x00, 0x00, 0x00, 0x00, 0x00, 0x00, 0x00
};
static const unsigned char menu_top_bitmap_bytes[] = {
    0x00, 0x00, 0x00, 0x00, 0x00, 0x00, 0x00, 0x00, 
    0x00, 0x00, 0x00, 0x00, 0x00, 0x00, 0x00, 0x00, 
    0x00, 0x00, 0x00, 0x00, 0x00, 0x00, 0x00, 0x00, 
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    0x00, 0x00, 0x00, 0x00, 0x00, 0x00, 0x00, 0x00
};
static const unsigned char back_bitmap_bytes[] = {
    0x00, 0x00, 0x00, 0x00, 0x00, 0x00, 0x00, 0x00, 
    0x00, 0x00, 0x00, 0x00, 0x00, 0x00, 0x00, 0x00, 
    0x00, 0x00, 0x00, 0x00, 0x00, 0x00, 0x00, 0x00, 
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    0x00, 0x00, 0x00, 0x00, 0x00, 0x00, 0x00, 0x00
};


void U8G2SSD1306UI::ui_begin(PS2& ps2){
    u8g2_class.begin();
    u8g2_class.setFont(u8g2_font_ncenB08_tr);
    font_width=u8g2_class.getMaxCharWidth();
    font_height=u8g2_class.getMaxCharHeight();
    screen_width=u8g2_class.getDisplayWidth();
    screen_height=u8g2_class.getDisplayHeight();
    Rect screen_rect={0,0,screen_width,screen_height};
    game_screen_rect={(short)((screen_width-game_screen_width)/2),0,game_screen_width,screen_height};
    game_class.begin(screen_rect,game_screen_rect,ps2);
}

void U8G2SSD1306UI::set_list(ui_list_t* list,uint8_t list_length){
    ui_list=list;
    ui_list_length=list_length;
}

void U8G2SSD1306UI::set_current_ui_element(ui_element_t* ui_element){
    current_ui_element=ui_element;
}

void U8G2SSD1306UI::set_ui_layout(ui_layout ui_layout){
    switch(ui_layout){
        case CENTER: 
        current_ui_element->x=(screen_width-current_ui_element->w)/2;
        current_ui_element->y=(screen_height-current_ui_element->h)/2;
        break;

    }
}

void U8G2SSD1306UI::draw_logo(){

    set_ui_layout(CENTER);
    u8g2_class.drawBitmap(current_ui_element->x,current_ui_element->y,128/8,64,logo_bitmap_bytes);
}

void U8G2SSD1306UI::draw_menu_start(){
    set_ui_layout(CENTER);
    u8g2_class.drawBitmap(current_ui_element->x,current_ui_element->y,64/8,64,menu_start_bitmap_bytes);
}

void U8G2SSD1306UI::draw_menu_help(){
    set_ui_layout(CENTER);
    u8g2_class.drawBitmap(current_ui_element->x,current_ui_element->y,64/8,64,menu_help_bitmap_bytes);
}

void U8G2SSD1306UI::draw_menu_top_score(){
    set_ui_layout(CENTER);
    u8g2_class.drawBitmap(current_ui_element->x,current_ui_element->y,64/8,64,menu_top_bitmap_bytes);
}

void U8G2SSD1306UI::draw_menu_back_logo(){
    set_ui_layout(CENTER);
    u8g2_class.drawBitmap(current_ui_element->x,current_ui_element->y,64/8,64,back_bitmap_bytes);
}

void U8G2SSD1306UI::draw_game_ui(){
    game_class.loop(u8g2_class);
}
void U8G2SSD1306UI::draw_game_back_memu(){
    set_ui_layout(CENTER);
    u8g2_class.drawBitmap(current_ui_element->x,current_ui_element->y,64/8,64,back_bitmap_bytes);
}
void U8G2SSD1306UI::draw_help_context(){
    set_ui_layout(CENTER);
    /* ... */
}
void U8G2SSD1306UI::draw_help_back_menu(){
    set_ui_layout(CENTER);
    u8g2_class.drawBitmap(current_ui_element->x,current_ui_element->y,64/8,64,back_bitmap_bytes);
}
void U8G2SSD1306UI::draw_top_ui(){
    set_ui_layout(CENTER);
    /* ... */
}
void U8G2SSD1306UI::draw_top_back_menu(){
    set_ui_layout(CENTER);
    u8g2_class.drawBitmap(current_ui_element->x,current_ui_element->y,64/8,64,back_bitmap_bytes);
}


void U8G2SSD1306UI::draw_list(){
    for (uint8_t i = 0; i < ui_list_length; i++) {
        Serial.printf("str:%s\n",ui_list[i].str);
        u8g2_class.drawStr(current_ui_element->x,
                            current_ui_element->y + font_height * (i+1),
                            ui_list[i].str);
    }
}
int U8G2SSD1306UI::set_offset_vlaue(short *val,short *target_val,uint8_t speed){
    if (*val<*target_val){
        *val+=speed;
    }
    else if (*val>*target_val)
    {
        *val-=speed;
    }
    else return 0;
    return 1;
    
}
void U8G2SSD1306UI::ui_update(void_func_t* funcs,uint8_t funcs_num){
    // set_offset_vlaue(&text_pos.y,&y_target,1);
    u8g2_class.firstPage();
    do {
        /* loop code... */
        for(uint8_t i=0;i<funcs_num;i++){
            
            funcs[i].func();
        }
        
    } while ( u8g2_class.nextPage());

}